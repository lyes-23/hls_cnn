/ {
	amba_pl: amba_pl {
		ranges;
		compatible = "simple-bus";
		#address-cells = <1>;
		#size-cells = <1>;
		axi_gpio_0: axi_gpio@40020000 {
			xlnx,gpio-board-interface = "leds_8bits";
			compatible = "xlnx,axi-gpio-2.0" , "xlnx,xps-gpio-1.00.a";
			xlnx,all-outputs = <1>;
			#gpio-cells = <2>;
			xlnx,gpio-width = <8>;
			xlnx,rable = <0>;
			xlnx,dout-default = <0x00000000>;
			xlnx,is-dual = <0>;
			xlnx,ip-name = "axi_gpio";
			xlnx,tri-default-2 = <0xFFFFFFFF>;
			reg = <0x40020000 0x10000>;
			xlnx,all-inputs-2 = <0>;
			clocks = <&clkc 18>;
			xlnx,all-outputs-2 = <0>;
			gpio-controller;
			xlnx,interrupt-present = <0>;
			xlnx,gpio2-board-interface = "Custom";
			xlnx,edk-iptype = "PERIPHERAL";
			xlnx,dout-default-2 = <0x00000000>;
			xlnx,gpio2-width = <32>;
			status = "okay";
			clock-names = "s_axi_aclk";
			xlnx,use-board-flow;
			xlnx,tri-default = <0xFFFFFFFF>;
			xlnx,name = "axi_gpio_0";
			xlnx,all-inputs = <0>;
		};
		cnn_lenet_0: cnn_lenet@40030000 {
			compatible = "xlnx,cnn-lenet-1.0";
			xlnx,ii = "x";
			xlnx,s-axi-control-addr-width = <7>;
			xlnx,machine = <64>;
			xlnx,rable = <0>;
			xlnx,ip-name = "cnn_lenet";
			xlnx,s-axi-ctrl-bus-addr-width = <4>;
			reg = <0x40030000 0x10000 0x40040000 0x10000>;
			clocks = <&clkc 18>;
			xlnx,clk-period = <20>;
			xlnx,s-axi-control-data-width = <32>;
			xlnx,edk-iptype = "PERIPHERAL";
			status = "okay";
			clock-names = "ap_clk";
			xlnx,s-axi-ctrl-bus-data-width = <32>;
			xlnx,combinational = <0>;
			xlnx,latency = <595147>;
			xlnx,name = "cnn_lenet_0";
		};
	};
};
